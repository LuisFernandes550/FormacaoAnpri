/*********
  Rui Santos
  Complete project details at https://randomnerdtutorials.com  
*********/
#include <WiFi.h>
#include <HTTPClient.h>
#include <ArduinoJson.h>
#include <Wire.h>
#include <Adafruit_GFX.h>
#include <Adafruit_SSD1306.h>


String api_key = "e11c203a36a84283baecfb4b3a5ad4c7";  // Enter your API key
const char* ssid = "xxxxxxxxxxxxxxxxxxx";      // Enter your SSID
const char* pass = "xxxxxxxxxxxxxxxxxxxxxxx";               // Enter Password

String api_head = "http://api.weatherbit.io/v2.0/current?city=";   
#define SCREEN_WIDTH 128
#define SCREEN_HEIGHT 64

Adafruit_SSD1306 display(SCREEN_WIDTH, SCREEN_HEIGHT, &Wire, -1);


// Array bytes of the Weather icons

const unsigned char thunderstorm_rain [] PROGMEM = {
  0xff, 0xff, 0xff, 0xff, 0xff, 0xff, 0xff, 0xf0, 0xff, 0xff, 0xff, 0xff, 0xff, 0xff, 0xff, 0xf0,
  0xff, 0xff, 0xff, 0xff, 0xff, 0xff, 0xff, 0xf0, 0xff, 0xff, 0xff, 0xff, 0xff, 0xff, 0xff, 0xf0,
  0xff, 0xff, 0xff, 0xff, 0xff, 0x3f, 0xff, 0xf0, 0xff, 0xff, 0xff, 0xff, 0xef, 0x1f, 0xff, 0xf0,
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  0xff, 0xff, 0xff, 0xff, 0xff, 0xff, 0xff, 0xf0
};
const unsigned char cloudy [] PROGMEM = {
  // 'cloudy', 60x53px
  0xff, 0xff, 0xff, 0xff, 0xff, 0xff, 0xff, 0xf0, 0xff, 0xff, 0xff, 0xff, 0xff, 0xff, 0xff, 0xf0,
  0xff, 0xff, 0xff, 0xff, 0xff, 0xff, 0xff, 0xf0, 0xff, 0xff, 0xff, 0xff, 0xff, 0xff, 0xff, 0xf0,
  0xff, 0xff, 0xff, 0xff, 0xff, 0xff, 0xff, 0xf0, 0xff, 0xff, 0xff, 0xfe, 0x07, 0xff, 0xff, 0xf0,
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  0xff, 0xff, 0xff, 0xff, 0xff, 0xff, 0xff, 0xf0
};
const unsigned char drizzle [] PROGMEM = {
  // 'drizzle', 59x55px
  0xff, 0xff, 0xff, 0xff, 0xff, 0xff, 0xff, 0xe0, 0xff, 0xff, 0xff, 0xff, 0xff, 0xff, 0xff, 0xe0,
  0xff, 0xff, 0xff, 0xff, 0xff, 0xff, 0xff, 0xe0, 0xff, 0xff, 0xfc, 0x01, 0xff, 0xff, 0xff, 0xe0,
  0xff, 0xff, 0xf8, 0x00, 0x3f, 0xff, 0xff, 0xe0, 0xff, 0xff, 0xc0, 0x00, 0x07, 0xff, 0xff, 0xe0,
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  0xff, 0xff, 0xff, 0xff, 0xff, 0xff, 0xff, 0xe0
};
const unsigned char mist [] PROGMEM = {
  // 'mist', 59x54px
  0xff, 0xff, 0xff, 0xff, 0xff, 0xff, 0xff, 0xe0, 0xff, 0xff, 0xff, 0xff, 0xff, 0xff, 0xff, 0xe0,
  0xff, 0xff, 0xff, 0xff, 0xff, 0xff, 0xff, 0xe0, 0xff, 0xff, 0xff, 0xff, 0xff, 0xff, 0xff, 0xe0,
  0xff, 0xff, 0xff, 0xff, 0xff, 0xff, 0xff, 0xe0, 0xff, 0xff, 0xff, 0xff, 0xff, 0xff, 0xff, 0xe0,
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  0xff, 0xff, 0xff, 0xff, 0xff, 0xff, 0xff, 0xe0, 0xff, 0xff, 0xff, 0xff, 0xff, 0xff, 0xff, 0xe0
};
const unsigned char rain [] PROGMEM = {
  // 'rain', 59x55px
  0xff, 0xff, 0xff, 0xff, 0xff, 0xff, 0xff, 0xe0, 0xff, 0xff, 0xff, 0xff, 0xff, 0xff, 0xff, 0xe0,
  0xff, 0xff, 0xff, 0xc0, 0x3f, 0xff, 0xff, 0xe0, 0xff, 0xff, 0xff, 0x00, 0x0f, 0xff, 0xff, 0xe0,
  0xff, 0xff, 0xf8, 0x00, 0x01, 0xff, 0xff, 0xe0, 0xff, 0xff, 0xf0, 0x00, 0x00, 0xff, 0xff, 0xe0,
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  0xff, 0xff, 0xff, 0xff, 0xff, 0xff, 0xff, 0xe0
};
const unsigned char sleet [] PROGMEM = {
  // 'sleet', 60x54px
  0xff, 0xff, 0xff, 0xff, 0xff, 0xff, 0xff, 0xf0, 0xff, 0xff, 0xff, 0xff, 0xff, 0xff, 0xff, 0xf0,
  0xff, 0xff, 0xff, 0xff, 0xff, 0xff, 0xff, 0xf0, 0xff, 0xff, 0xff, 0xff, 0xff, 0xff, 0xff, 0xf0,
  0xff, 0xff, 0xff, 0xff, 0xff, 0xff, 0xff, 0xf0, 0xff, 0xff, 0xff, 0xff, 0xff, 0xff, 0xff, 0xf0,
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  0xff, 0xff, 0xff, 0xff, 0xff, 0xff, 0xff, 0xf0, 0xff, 0xff, 0xff, 0xff, 0xff, 0xff, 0xff, 0xf0
};
const unsigned char snow [] PROGMEM = {
  // 'snow(1)', 57x58px
  0xff, 0xff, 0xff, 0xf0, 0xff, 0xff, 0xff, 0x80, 0xff, 0xff, 0xff, 0xf0, 0x7f, 0xff, 0xff, 0x80,
  0xff, 0xff, 0xff, 0xe0, 0x7f, 0xff, 0xff, 0x80, 0xff, 0xff, 0xff, 0xe0, 0x3f, 0xff, 0xff, 0x80,
  0xff, 0xff, 0xff, 0xf0, 0x7f, 0xff, 0xff, 0x80, 0xff, 0xff, 0xff, 0xf0, 0x7f, 0xff, 0xff, 0x80,
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  0xff, 0xff, 0xff, 0xf0, 0xff, 0xff, 0xff, 0x80, 0xff, 0xff, 0xff, 0xf9, 0xff, 0xff, 0xff, 0x80
};
const unsigned char thunderstrom_drizzle [] PROGMEM = {
  // 'thunderstorm with drizzle', 59x55px
  0xff, 0xff, 0xff, 0xff, 0xff, 0xff, 0xff, 0xe0, 0xff, 0xff, 0xff, 0xff, 0xff, 0xff, 0xff, 0xe0,
  0xff, 0xff, 0xff, 0xff, 0xff, 0xff, 0xff, 0xe0, 0xff, 0xff, 0xff, 0xff, 0xff, 0xff, 0xff, 0xe0,
  0xff, 0xff, 0xff, 0xff, 0xff, 0xff, 0xff, 0xe0, 0xff, 0xff, 0xff, 0xff, 0xff, 0xff, 0xff, 0xe0,
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  0xff, 0xff, 0xf7, 0xff, 0xff, 0xff, 0xff, 0xe0
};
const unsigned char unknown_prep [] PROGMEM = {
  // 'unknown prep', 59x54px
  0xff, 0xff, 0xff, 0xff, 0xff, 0xff, 0xff, 0xe0, 0xff, 0xff, 0xff, 0xff, 0xff, 0xff, 0xff, 0xe0,
  0xff, 0xff, 0xff, 0xff, 0xff, 0xff, 0xff, 0xe0, 0xff, 0xff, 0xff, 0xff, 0xff, 0xff, 0xff, 0xe0,
  0xff, 0xff, 0xff, 0xff, 0xff, 0xff, 0xff, 0xe0, 0xff, 0xff, 0xff, 0xff, 0xff, 0xff, 0xff, 0xe0,
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  0xff, 0xff, 0xff, 0xff, 0xff, 0xff, 0xff, 0xe0, 0xff, 0xff, 0xff, 0xff, 0xff, 0xff, 0xff, 0xe0
};


void setup() {  //testa os icones e estabelece a ligação WIFI
  Serial.begin(115200);
 
  if(!display.begin(SSD1306_SWITCHCAPVCC, 0x3C)) {
    Serial.println(F("SSD1306 allocation failed"));
    for(;;);
  }
  delay(2000); // Pause for 2 seconds
 
  // Clear the buffer.
  display.clearDisplay();
  
 // Displays all the weather icons 
  Serial.begin(115200);
  display.begin(SSD1306_SWITCHCAPVCC, 0x3C);  
  delay(300);
  display.clearDisplay();
  display.drawBitmap(0, 0, thunderstorm_rain, 57, 56, BLACK, WHITE);
  display.display();
  delay(300);
  display.clearDisplay();
  display.drawBitmap(0, 0, thunderstrom_drizzle, 57, 56, BLACK, WHITE);
  display.display();
  delay(300);
  display.clearDisplay();
  display.drawBitmap(0, 0, drizzle, 57, 54, BLACK, WHITE);
  display.display();
  delay(300);
  display.clearDisplay();
  display.drawBitmap(0, 0, rain, 57, 54, BLACK, WHITE);
  display.display();
  delay(300);
  display.clearDisplay();
  display.drawBitmap(0, 0, snow, 57, 54, BLACK, WHITE);
  display.display();
  delay(300);
  display.clearDisplay();
  display.drawBitmap(0, 0, sleet, 57, 54, BLACK, WHITE);
  display.display();
  delay(300);
  display.clearDisplay();
  display.drawBitmap(0, 0, mist, 57, 54, BLACK, WHITE);
  display.display();
  delay(300);
  display.clearDisplay();
  display.drawBitmap(0, 0, cloudy, 57, 54, BLACK, WHITE);
  display.display();
  delay(300);
  display.clearDisplay();
  display.drawBitmap(0, 0, unknown_prep, 57, 54, BLACK, WHITE);
  display.display();
  delay(300);
  display.clearDisplay();
  display.fillCircle(30, 30, 20, WHITE);
  display.display();
  delay(500);

 
  display.clearDisplay();
  display.setTextColor(WHITE);
  display.setCursor(0, 0);
  display.setTextSize(2);
  display.println("OLED");
  display.println("WEATHER");
  display.println("MOnitORING");
  display.display();
  delay(1000);
  display.invertDisplay(1);
  delay(500);

  // displays ssid of the router to be connected
  display.invertDisplay(0);
  display.clearDisplay();
  display.setCursor(0, 0);
  display.setTextColor(WHITE);
  display.setTextSize(2);
  display.println("CONNECTING");
  display.setCursor(52, 16);
  display.println("TO");
  display.setTextSize(1);
  display.println(ssid);
  display.display();
  WiFi.begin(ssid, pass);
  // Will try for about 10 seconds (20x 500ms)
    int tryDelay = 500;
    int numberOfTries = 20;

    // Wait for the WiFi event
    while (true) {
        
        switch(WiFi.status()) {
          case WL_NO_SSID_AVAIL:
            Serial.println("[WiFi] SSID not found");
            break;
          case WL_CONNECT_FAILED:
            Serial.print("[WiFi] Failed - WiFi not connected! Reason: ");
            return;
            break;
          case WL_CONNECTION_LOST:
            Serial.println("[WiFi] Connection was lost");
            break;
          case WL_SCAN_COMPLETED:
            Serial.println("[WiFi] Scan is completed");
            break;
          case WL_DISCONNECTED:
            Serial.println("[WiFi] WiFi is disconnected");
            break;
          case WL_CONNECTED:
            Serial.println("[WiFi] WiFi is connected!");
            Serial.print("[WiFi] IP address: ");
            Serial.println(WiFi.localIP());
            return;
            break;
          default:
            Serial.print("[WiFi] WiFi Status: ");
            Serial.println(WiFi.status());
            break;
        }
        delay(tryDelay);
        
        if(numberOfTries <= 0){
          Serial.print("[WiFi] Failed to connect to WiFi!");
          // Use disconnect function to force stop trying to connect
          WiFi.disconnect();
          return;
        } else {
          numberOfTries--;
        }
    }
  display.setCursor(0, 48);
  display.setTextSize(2);
  display.setTextColor(BLACK, WHITE);
  display.print("Connected");
  display.display();
  delay(500);
  display.clearDisplay();
  display.setTextColor(WHITE);
  
}
 
String payload;
void loop() {
  
  HTTPClient http;
  String main_head = "";
  main_head = api_head + "Setúbal";
  main_head = main_head + "&country=PT&units=M&key=";
  main_head = main_head + api_key;
  http.begin(main_head);
  int httpcode = http.GET();
  display.clearDisplay();
  
  if (httpcode != 200)    // Not an OK response
  {
    display.setTextSize(1);
    display.setCursor(0, 32);
    display.println("Please Wait.....");
    display.println("");
    display.print("Is internet available??");
    display.display();
    Serial.println(main_head);
    delay(1000);
    return;
  }

  // Success response
  else
  {
    // payload=http.getString();
    // Serial.println(payload);

    // Parsing
    const size_t buffersize = JSON_ARRAY_SIZE(1) + JSON_OBJECT_SIZE(2) + JSON_OBJECT_SIZE(3) + JSON_OBJECT_SIZE(36);
    DynamicJsonBuffer jsonBuffer(buffersize);

    JsonObject& root = jsonBuffer.parseObject(http.getString());
    JsonObject& current_obs = root["data"][0];
    JsonObject& current_desc = current_obs["weather"];

    const char* city_name = current_obs["city_name"];
    float curr_temp = current_obs["temp"];
    int air_quality = current_obs["aqi"];
    float app_temp = current_obs["app_temp"];
    float wind_spd = current_obs["wind_spd"];
    const char* wind_cdir = current_obs["wind_cdir"];
    const char* sunrise = current_obs["sunrise"];
    const char* sunset = current_obs["sunset"];
    const char* desc = current_desc["description"];
    int code = current_desc["code"];

    displaywidget(code);
  

    /* For verification on Serial Monitor
        Serial.print(city_name);
      Serial.print("\t");
      Serial.print(air_quality);
      Serial.print("\t");
      Serial.print(app_temp);
      Serial.print("\t");
      Serial.print(wind_spd);
      Serial.print("/");
      Serial.print(wind_cdir);
      Serial.print("\t");
      Serial.print(desc);
      Serial.println(code);
    */
    display.clearDisplay();
    delay(1000);
    // Details displayed on the OLED
    display.setCursor(62, 0);
    display.setTextSize(2);
    display.println("Stb");
    display.setTextSize(1);
    display.setCursor(62, 20);
    display.print(city_name);   // Prints city name ie: Marmagao in my case
    display.drawLine(62, 28, 127, 28, WHITE);
    
    display.setCursor(62, 32);
    display.setTextSize(2);
    display.print(curr_temp);
    display.setTextSize(1);
    display.setCursor(62, 48);
    display.print(wind_spd);
    display.print("m/s ");
    display.println(wind_cdir);
    display.setCursor(0, 56);
    display.print(desc);
    display.print("\t");
    display.print("");
    //display.startscrollleft(0x07, 0x07);
    display.display();
    delay(10000);
   // display.stopscroll();
  }
  http.end();

}

// Allocating the Weather icon based on their respective icon code

void displaywidget(int code_no)
{
 display.clearDisplay();
  if (200 <= code_no and code_no <= 202)
    display.drawBitmap(0, 0, thunderstorm_rain, 57, 56, BLACK, WHITE);
  else if (230 <= code_no and code_no <= 233)
    display.drawBitmap(0, 0, thunderstrom_drizzle, 57, 56, BLACK, WHITE);
  else if (300 <= code_no and code_no <= 302)
    display.drawBitmap(0, 0, drizzle, 57, 54, BLACK, WHITE);
  else if (500 <= code_no and code_no <= 522)
    display.drawBitmap(0, 0, rain, 57, 54, BLACK, WHITE);
  else if ((600 <= code_no and code_no <= 610) or(621 <= code_no and code_no <= 623))
    display.drawBitmap(0, 0, snow, 57, 54, BLACK, WHITE);
  else if (611<= code_no and code_no <= 612)
    display.drawBitmap(0, 0, sleet, 57, 54, BLACK, WHITE);
  else if (700 <= code_no and code_no <= 751)
    display.drawBitmap(0, 0, mist, 57, 54, BLACK, WHITE);
  else if (801 <= code_no and code_no <= 804)
    display.drawBitmap(0, 0, cloudy, 57, 54, BLACK, WHITE);
  else if (code_no == 900)
    display.drawBitmap(0, 0, unknown_prep, 57, 54, BLACK, WHITE);
  else
    display.fillCircle(30, 30, 20, WHITE);   // sunny day

}