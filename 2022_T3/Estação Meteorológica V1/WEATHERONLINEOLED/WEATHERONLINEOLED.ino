
#include <WiFi.h>
#include <ArduinoJson.h>
#include <Wire.h>
#include <Adafruit_GFX.h>
#include <Adafruit_SSD1306.h>

Adafruit_SSD1306 display(128, 64, &Wire, -1);
// Array bytes of the Weather icons

const unsigned char thunderstorm_rain [] PROGMEM = {
  0xff, 0xff, 0xff, 0xff, 0xff, 0xff, 0xff, 0xf0, 0xff, 0xff, 0xff, 0xff, 0xff, 0xff, 0xff, 0xf0,
  0xff, 0xff, 0xff, 0xff, 0xff, 0xff, 0xff, 0xf0, 0xff, 0xff, 0xff, 0xff, 0xff, 0xff, 0xff, 0xf0,
  0xff, 0xff, 0xff, 0xff, 0xff, 0x3f, 0xff, 0xf0, 0xff, 0xff, 0xff, 0xff, 0xef, 0x1f, 0xff, 0xf0,
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  0xff, 0xff, 0xff, 0xff, 0xff, 0xff, 0xff, 0xf0
};
const unsigned char cloudy [] PROGMEM = {
  // 'cloudy', 60x53px
  0xff, 0xff, 0xff, 0xff, 0xff, 0xff, 0xff, 0xf0, 0xff, 0xff, 0xff, 0xff, 0xff, 0xff, 0xff, 0xf0,
  0xff, 0xff, 0xff, 0xff, 0xff, 0xff, 0xff, 0xf0, 0xff, 0xff, 0xff, 0xff, 0xff, 0xff, 0xff, 0xf0,
  0xff, 0xff, 0xff, 0xff, 0xff, 0xff, 0xff, 0xf0, 0xff, 0xff, 0xff, 0xfe, 0x07, 0xff, 0xff, 0xf0,
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  0xff, 0xff, 0xff, 0xff, 0xff, 0xff, 0xff, 0xf0
};
const unsigned char drizzle [] PROGMEM = {
  // 'drizzle', 59x55px
  0xff, 0xff, 0xff, 0xff, 0xff, 0xff, 0xff, 0xe0, 0xff, 0xff, 0xff, 0xff, 0xff, 0xff, 0xff, 0xe0,
  0xff, 0xff, 0xff, 0xff, 0xff, 0xff, 0xff, 0xe0, 0xff, 0xff, 0xfc, 0x01, 0xff, 0xff, 0xff, 0xe0,
  0xff, 0xff, 0xf8, 0x00, 0x3f, 0xff, 0xff, 0xe0, 0xff, 0xff, 0xc0, 0x00, 0x07, 0xff, 0xff, 0xe0,
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  0xff, 0xff, 0xff, 0xff, 0xff, 0xff, 0xff, 0xe0
};
const unsigned char mist [] PROGMEM = {
  // 'mist', 59x54px
  0xff, 0xff, 0xff, 0xff, 0xff, 0xff, 0xff, 0xe0, 0xff, 0xff, 0xff, 0xff, 0xff, 0xff, 0xff, 0xe0,
  0xff, 0xff, 0xff, 0xff, 0xff, 0xff, 0xff, 0xe0, 0xff, 0xff, 0xff, 0xff, 0xff, 0xff, 0xff, 0xe0,
  0xff, 0xff, 0xff, 0xff, 0xff, 0xff, 0xff, 0xe0, 0xff, 0xff, 0xff, 0xff, 0xff, 0xff, 0xff, 0xe0,
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  0xff, 0xff, 0xff, 0xff, 0xff, 0xff, 0xff, 0xe0, 0xff, 0xff, 0xff, 0xff, 0xff, 0xff, 0xff, 0xe0
};
const unsigned char rain [] PROGMEM = {
  // 'rain', 59x55px
  0xff, 0xff, 0xff, 0xff, 0xff, 0xff, 0xff, 0xe0, 0xff, 0xff, 0xff, 0xff, 0xff, 0xff, 0xff, 0xe0,
  0xff, 0xff, 0xff, 0xc0, 0x3f, 0xff, 0xff, 0xe0, 0xff, 0xff, 0xff, 0x00, 0x0f, 0xff, 0xff, 0xe0,
  0xff, 0xff, 0xf8, 0x00, 0x01, 0xff, 0xff, 0xe0, 0xff, 0xff, 0xf0, 0x00, 0x00, 0xff, 0xff, 0xe0,
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  0xff, 0xff, 0xff, 0xff, 0xff, 0xff, 0xff, 0xe0
};
const unsigned char sleet [] PROGMEM = {
  // 'sleet', 60x54px
  0xff, 0xff, 0xff, 0xff, 0xff, 0xff, 0xff, 0xf0, 0xff, 0xff, 0xff, 0xff, 0xff, 0xff, 0xff, 0xf0,
  0xff, 0xff, 0xff, 0xff, 0xff, 0xff, 0xff, 0xf0, 0xff, 0xff, 0xff, 0xff, 0xff, 0xff, 0xff, 0xf0,
  0xff, 0xff, 0xff, 0xff, 0xff, 0xff, 0xff, 0xf0, 0xff, 0xff, 0xff, 0xff, 0xff, 0xff, 0xff, 0xf0,
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  0xff, 0xff, 0xff, 0xff, 0xff, 0xff, 0xff, 0xf0, 0xff, 0xff, 0xff, 0xff, 0xff, 0xff, 0xff, 0xf0
};
const unsigned char snow [] PROGMEM = {
  // 'snow(1)', 57x58px
  0xff, 0xff, 0xff, 0xf0, 0xff, 0xff, 0xff, 0x80, 0xff, 0xff, 0xff, 0xf0, 0x7f, 0xff, 0xff, 0x80,
  0xff, 0xff, 0xff, 0xe0, 0x7f, 0xff, 0xff, 0x80, 0xff, 0xff, 0xff, 0xe0, 0x3f, 0xff, 0xff, 0x80,
  0xff, 0xff, 0xff, 0xf0, 0x7f, 0xff, 0xff, 0x80, 0xff, 0xff, 0xff, 0xf0, 0x7f, 0xff, 0xff, 0x80,
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  0xff, 0xff, 0xff, 0xf0, 0xff, 0xff, 0xff, 0x80, 0xff, 0xff, 0xff, 0xf9, 0xff, 0xff, 0xff, 0x80
};
const unsigned char thunderstrom_drizzle [] PROGMEM = {
  // 'thunderstorm with drizzle', 59x55px
  0xff, 0xff, 0xff, 0xff, 0xff, 0xff, 0xff, 0xe0, 0xff, 0xff, 0xff, 0xff, 0xff, 0xff, 0xff, 0xe0,
  0xff, 0xff, 0xff, 0xff, 0xff, 0xff, 0xff, 0xe0, 0xff, 0xff, 0xff, 0xff, 0xff, 0xff, 0xff, 0xe0,
  0xff, 0xff, 0xff, 0xff, 0xff, 0xff, 0xff, 0xe0, 0xff, 0xff, 0xff, 0xff, 0xff, 0xff, 0xff, 0xe0,
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  0xff, 0xff, 0xf7, 0xff, 0xff, 0xff, 0xff, 0xe0
};
const unsigned char unknown_prep [] PROGMEM = {
  // 'unknown prep', 59x54px
  0xff, 0xff, 0xff, 0xff, 0xff, 0xff, 0xff, 0xe0, 0xff, 0xff, 0xff, 0xff, 0xff, 0xff, 0xff, 0xe0,
  0xff, 0xff, 0xff, 0xff, 0xff, 0xff, 0xff, 0xe0, 0xff, 0xff, 0xff, 0xff, 0xff, 0xff, 0xff, 0xe0,
  0xff, 0xff, 0xff, 0xff, 0xff, 0xff, 0xff, 0xe0, 0xff, 0xff, 0xff, 0xff, 0xff, 0xff, 0xff, 0xe0,
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  0xff, 0xff, 0xff, 0xff, 0xff, 0xff, 0xff, 0xe0, 0xff, 0xff, 0xff, 0xff, 0xff, 0xff, 0xff, 0xe0
};

const unsigned char sol [] PROGMEM = {
	0xff, 0xff, 0xff, 0xff, 0xff, 0xff, 0xff, 0xff, 0xff, 0xff, 0xff, 0xff, 0xff, 0xff, 0xff, 0xff, 
	0xff, 0xff, 0xff, 0xff, 0xff, 0xff, 0xff, 0xff, 0xff, 0xff, 0xff, 0xff, 0xff, 0xff, 0xff, 0xff, 
	0xff, 0xff, 0xff, 0xff, 0xff, 0xff, 0xff, 0xff, 0xff, 0xff, 0xff, 0xff, 0xff, 0xff, 0xff, 0xff, 
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	0xff, 0xff, 0xff, 0xff, 0xff, 0xff, 0xff, 0xff, 0xff, 0xff, 0xff, 0xff, 0xff, 0xff, 0xff, 0xff
};
const char* ssid     = "xxxxxxxxxxxxxxxxxxxxx";                 // SSID of local network
const char* password = "xxxxxxxxxxxxxxxxxxxxxxxxx";                    // Password on network
String APIKEY = "53c1a08909532fdf41f09935d9dea67d";
String CityID = "8010625";          //Your City ID
bool id = false;
WiFiClient client;
char servername[] = "api.openweathermap.org";            // remote server we will connect to
String result;


void setup() {


   Serial.begin(115200);

  Serial.print("Connecting to ");
  WiFi.mode(WIFI_STA);   //   create wifi station
  Serial.println(ssid);
  WiFi.begin(ssid, password);

  // SSD1306_SWITCHCAPVCC = generate display voltage from 3.3V internally
  display.begin(SSD1306_SWITCHCAPVCC, 0x3C); // Address 0x3D for 128x64
  delay(200);
  display.clearDisplay();
  display.setTextSize(1);             // Normal 1:1 pixel scale
  display.setTextColor(SSD1306_WHITE);        // Draw white text
  display.setCursor(0, 0);            // Start at top-left corner
  display.print("Connecting.");
  display.display();
  while (WiFi.status() != WL_CONNECTED) {
    delay(500);
    Serial.print(".");
    display.print(".");
    display.display();
  }

  Serial.println("");
  Serial.println("IP address: ");
  Serial.println(WiFi.localIP());
  display.clearDisplay();
  display.setCursor(0, 0);
  display.println("Connected ");
  display.println("IP Address: ");
  display.println(WiFi.localIP());
  display.display();
  delay(1000);
  display.clearDisplay();

}

void loop2()                    
{
  if (client.connect(servername, 80))
  { //starts client connection, checks for connection
    client.println("GET /data/2.5/weather?id=" + CityID + "&units=metric&APPID=" + APIKEY+"&lang=pt");
    client.println("Host: api.openweathermap.org");
    client.println("User-Agent: ArduinoWiFi/1.1");
    client.println("Connection: close");
    client.println();
  }
  else {
    Serial.println("connection failed");        //error message if no client connect
    Serial.println();
  }

  while (client.connected() && !client.available())
    delay(1);                                          //waits for data
  while (client.connected() || client.available())
  { //connected or data available
    char c = client.read();                     //gets byte from ethernet buffer
    result = result + c;
  }

  client.stop();                                      //stop client
  result.replace('[', ' ');
  result.replace(']', ' ');
  //Serial.println(result);
  char jsonArray [result.length() + 1];
  result.toCharArray(jsonArray, sizeof(jsonArray));
  jsonArray[result.length() + 1] = '\0';
  StaticJsonDocument<1024> doc;
  DeserializationError  error = deserializeJson(doc, jsonArray);


  if (error) {
    Serial.print(F("deserializeJson() failed with code "));
    Serial.println(error.c_str());
    return;
  }

  String location = doc["name"];
  String country = doc["sys"]["country"];
  int temperature = doc["main"]["temp"];
  int humidity = doc["main"]["humidity"];
  float pressure = doc["main"]["pressure"];
  int id = doc["id"];
  float Speed = doc["wind"]["speed"];
  int degree = doc["wind"]["deg"];
  float longitude = doc["coord"]["lon"];
  float latitude = doc["coord"]["lat"];
  int tempo =doc ["weather"] ["id"];//tipo de tempo para mostrar figura

  Serial.println();
  Serial.print("Country: ");
  Serial.println(country);
  Serial.print("Location: ");
  Serial.println(location);
  Serial.print("Location ID: ");
  Serial.println(id);
  Serial.printf("Temperature: %d°C\r\n", temperature);
  Serial.printf("Humidity: %d %%\r\n", humidity);
  Serial.printf("Pressure: %.2f hpa\r\n", pressure);
  Serial.printf("Wind speed: %.1f m/s\r\n", Speed);
  Serial.printf("Wind degree: %d°\r\n", degree);
  Serial.printf("Longitude: %.2f\r\n", longitude);
  Serial.printf("Latitude: %.2f\r\n", latitude);
  Serial.print("TEMPO Esperado");Serial.print(tempo);  //tempo esperado Rain, Snow, Extreme, Clear, Drizzle ,Atmosphere ,Clouds -codigo numerico do site openweather


  display.clearDisplay();
  display.setCursor(0, 0);            // Start at top-left corner
  display.setTextColor(SSD1306_BLACK, SSD1306_WHITE);
  display.print("Local: ");
  display.print(country);
  display.print(" ");
  display.println(location);
 
  //display.println();
  display.setTextColor(SSD1306_WHITE, SSD1306_BLACK);
  display.print("Temp: ");
  display.print(temperature);
  display.print((char)247);
  display.print("C ");
  display.print("Humid: ");
  display.print(humidity);
  display.println("%");
  display.print("Pressao:");
  display.print(pressure);
  display.println("hpa");
  display.print("WinDSpeed: ");
  display.print(Speed);
  display.print("m/s   ");
  /*display.println("WA: ");
  display.print(degree);
  display.println((char)247);*/
  display.print("Latitude: ");
  display.print(latitude);
  display.println(" ");
  display.print("Longitude:");
  display.print(longitude);
  display.setTextColor(SSD1306_BLACK, SSD1306_WHITE);
  
  display.display();
  
  delay(5000);
  display.clearDisplay();
  displaywidget(tempo);
  display.display();
  delay(600000);     // espra 10 minutos para nao esgotar o plafond de consultas gratis  ao site

}


void displaywidget(int code_no)
{
  if (200 <= code_no and code_no <= 202)
    display.drawBitmap(0, 0, thunderstorm_rain, 57, 56, BLACK, WHITE);
  else if (230 <= code_no and code_no <= 233)
    display.drawBitmap(0, 0, thunderstrom_drizzle, 57, 56, BLACK, WHITE);
  else if (300 <= code_no and code_no <= 321)
    display.drawBitmap(0, 0, drizzle, 57, 54, BLACK, WHITE);
  else if (500 <= code_no and code_no <= 522)
    display.drawBitmap(0, 0, rain, 57, 54, BLACK, WHITE);
  else if ((600 <= code_no and code_no <= 610) or(620 <= code_no and code_no <= 622))
    display.drawBitmap(0, 0, snow, 57, 54, BLACK, WHITE);
  else if (612<= code_no and code_no <= 613)
    display.drawBitmap(0, 0, sleet, 57, 54, BLACK, WHITE);
  else if (700 <= code_no and code_no <= 771)
    display.drawBitmap(0, 0, mist, 57, 54, BLACK, WHITE);
  else if (801 <= code_no and code_no <= 804)
    display.drawBitmap(0, 0, cloudy, 57, 54, BLACK, WHITE);
  else if (code_no == 900)
    display.drawBitmap(0, 0, unknown_prep, 57, 54, BLACK, WHITE);
  else
    //
    display.drawBitmap(30, 0, sol, 57, 54, BLACK, WHITE);
    //display.fillCircle(60, 30, 20, WHITE);   // sunny day
   // display.fillCircle()

}