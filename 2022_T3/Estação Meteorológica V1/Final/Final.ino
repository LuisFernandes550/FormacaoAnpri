#include <WiFi.h>         //para utilizar o wifi da ESP32
#include <ArduinoJson.h>  //para interpertar os dados recebidos por http
#include "ESPAsyncWebServer.h"

#include <Adafruit_GFX.h>
#include <Adafruit_SSD1306.h>   //biblioteca do ecra OLED
#include <Adafruit_BMP280.h>    //livraria sensor bmp280
#include <LiquidCrystal_I2C.h>  //biblioteca do LCD

// Declaration for an SSD1306 display connected to I2C (SDA, SCL pins)
#define SCREEN_WIDTH 128                                                   // OLED display width, in pixels
#define SCREEN_HEIGHT 64                                                   // OLED display height, in pixels
#define OLED_RESET -1                                                      // Reset pin # (or -1 if sharing Arduino reset pin)
Adafruit_SSD1306 display(SCREEN_WIDTH, SCREEN_HEIGHT, &Wire, OLED_RESET);  //define o ecrã oled

#include <Wire.h>
#include <BH1750.h>  //sensor de  luminosidade bh1750

#include "DHT.h"  //biblioteca sensor de humidade e temperatura DHT11 pino 16

#define DHTPIN 16          //ligado ao pino GPIO16 do ESP32
#define DHTTYPE DHT11      // DHT 11
DHT dht(DHTPIN, DHTTYPE);  //inicaliza o sensor DHT11

Adafruit_BMP280 bmp;                 //  sensor BMP280
BH1750 lightMeter;                   //sensor de luz
LiquidCrystal_I2C lcd(0x27, 16, 2);  //define o endereço, numero de linhas e colunas do LCD 16*2


AsyncWebServer server(80);  //servidor web na porta 80
AsyncEventSource events("/events");

/************************pagna web onde vao surgir os dados dos sensores /*//////////////////////////////////////////////
const char index_html[] PROGMEM = R"rawliteral(
<!DOCTYPE HTML><html>
<head>
  <title>MultiSensor Web Server V1.0 - Antonio Guerreiro 2023</title>
  <meta name="viewport" content="width=device-width, initial-scale=1">
  <meta http-equiv="refresh" content="20">
  <link rel="stylesheet" href="https://use.fontawesome.com/releases/v5.7.2/css/all.css" integrity="sha384-fnmOCqbTlWIlj8LyTjo7mOUStjsKC4pOpQbqyi7RrhN7udi9RwhKkMHpvLbHG9Sr" crossorigin="anonymous">
  <link rel="icon" href="data:,">
  <style>
    html {font-family: Arial; display: inline-block; text-align: center;}
    p {  font-size: 1.2rem;}
    body {  margin: 0;}
    .topnav { overflow: hidden; background-color: #4B1D3F; color: white; font-size: 1.7rem; }
    .content { padding: 20px; }
    .card { background-color: white; box-shadow: 2px 2px 12px 1px rgba(140,140,140,.5); }
    .cards { max-width: 700px; margin: 0 auto; display: grid; grid-gap: 2rem; grid-template-columns: repeat(auto-fit, minmax(300px, 1fr)); }
    .reading { font-size: 2.8rem; }
    .card.temperature { color: #0e7c7b; }
    .card.humidity { color: #17bebb; }
    .card.lux { color: #17becc;}
    .card.altitude { color: #17becc;}
  </style>
</head>
<body>
  <div class="topnav">
    <h3>Valores do Sensores em Tempo Real</h3>
  </div>
  <div class="content">
    <div class="cards">
      <div class="card temperature">
        <h4><i class="fas fa-thermometer-half"></i> TEMPERATURA CELSIUS</h4><p><span class="reading"><span id="temp_celcius">%TEMPERATURE_C%</span> &deg;C</span></p>
      </div>
      <div class="card temperature">
        <h4><i class="fas fa-thermometer-half"></i> TEMPERATURA FAHRENHEIT</h4><p><span class="reading"><span id="temp_fahrenheit">%TEMPERATURE_F%</span> &deg;F</span></p>
      </div>
      <div class="card humidity">
        <h4><i class="fas fa-tint"></i> HUMIDADE</h4><p><span class="reading"><span id="hum">%HUMIDITY%</span> &percnt;</span></p>
      </div>
      <div class="card lux">
        <h4><i class="fas fa-lightbulb"></i> LUMINOSIDADE</h4><p><span class="reading"><span id="temp_fahrenheit">%lux%</span> lux</span></p>
      </div>
      <div class="card altitude">
        <h4><i class="fas fa-ruler-vertical"></i> ALTITUDE APROXIMADA</h4><p><span class="reading"><span id="temp_fahrenheit">%altitude%</span> metros</span></p>
      </div>
    </div>
  </div>
<script>
if (!!window.EventSource) {
 var source = new EventSource('/events');
 
 source.addEventListener('open', function(e) {
  console.log("Events Connected");
 }, false);
 source.addEventListener('error', function(e) {
  if (e.target.readyState != EventSource.OPEN) {
    console.log("Events Disconnected");
  }
 }, false);
 
 source.addEventListener('message', function(e) {
  console.log("message", e.data);
 }, false);
 
 source.addEventListener('temperature_Celsius', function(e) {
  console.log("temperature", e.data);
  document.getElementById("temp_celcius").innerHTML = e.data;
 }, false);
 
 source.addEventListener('temperature_Fahrenheit', function(e) {
  console.log("temperature", e.data);
  document.getElementById("temp_fahrenheit").innerHTML = e.data;
 }, false);
 source.addEventListener('humidity', function(e) {
  console.log("humidity", e.data);
  document.getElementById("hum").innerHTML = e.data;
 }, false);
 
 source.addEventListener('lux', function(e) {
  console.log("lux", e.data);
  document.getElementById("hum").innerHTML = e.data;
 }, false);
}
</script>
</body>
</html>)rawliteral";
/***********************************************************************************************************************/

// Array em bytes of the dos icones do tempo

const unsigned char thunderstorm_rain[] PROGMEM = {
  0xff, 0xff, 0xff, 0xff, 0xff, 0xff, 0xff, 0xf0, 0xff, 0xff, 0xff, 0xff, 0xff, 0xff, 0xff, 0xf0,
  0xff, 0xff, 0xff, 0xff, 0xff, 0xff, 0xff, 0xf0, 0xff, 0xff, 0xff, 0xff, 0xff, 0xff, 0xff, 0xf0,
  0xff, 0xff, 0xff, 0xff, 0xff, 0x3f, 0xff, 0xf0, 0xff, 0xff, 0xff, 0xff, 0xef, 0x1f, 0xff, 0xf0,
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  0xff, 0xff, 0xff, 0xff, 0xff, 0xff, 0xff, 0xf0
};
const unsigned char cloudy[] PROGMEM = {
  // 'cloudy', 60x53px
  0xff, 0xff, 0xff, 0xff, 0xff, 0xff, 0xff, 0xf0, 0xff, 0xff, 0xff, 0xff, 0xff, 0xff, 0xff, 0xf0,
  0xff, 0xff, 0xff, 0xff, 0xff, 0xff, 0xff, 0xf0, 0xff, 0xff, 0xff, 0xff, 0xff, 0xff, 0xff, 0xf0,
  0xff, 0xff, 0xff, 0xff, 0xff, 0xff, 0xff, 0xf0, 0xff, 0xff, 0xff, 0xfe, 0x07, 0xff, 0xff, 0xf0,
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  0xff, 0xff, 0xff, 0xff, 0xff, 0xff, 0xff, 0xf0
};
const unsigned char drizzle[] PROGMEM = {
  // 'drizzle', 59x55px
  0xff, 0xff, 0xff, 0xff, 0xff, 0xff, 0xff, 0xe0, 0xff, 0xff, 0xff, 0xff, 0xff, 0xff, 0xff, 0xe0,
  0xff, 0xff, 0xff, 0xff, 0xff, 0xff, 0xff, 0xe0, 0xff, 0xff, 0xfc, 0x01, 0xff, 0xff, 0xff, 0xe0,
  0xff, 0xff, 0xf8, 0x00, 0x3f, 0xff, 0xff, 0xe0, 0xff, 0xff, 0xc0, 0x00, 0x07, 0xff, 0xff, 0xe0,
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  0xff, 0xff, 0xff, 0xff, 0xff, 0xff, 0xff, 0xe0
};
const unsigned char mist[] PROGMEM = {
  // 'mist', 59x54px
  0xff, 0xff, 0xff, 0xff, 0xff, 0xff, 0xff, 0xe0, 0xff, 0xff, 0xff, 0xff, 0xff, 0xff, 0xff, 0xe0,
  0xff, 0xff, 0xff, 0xff, 0xff, 0xff, 0xff, 0xe0, 0xff, 0xff, 0xff, 0xff, 0xff, 0xff, 0xff, 0xe0,
  0xff, 0xff, 0xff, 0xff, 0xff, 0xff, 0xff, 0xe0, 0xff, 0xff, 0xff, 0xff, 0xff, 0xff, 0xff, 0xe0,
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  0xff, 0xff, 0xff, 0xff, 0xff, 0xff, 0xff, 0xe0, 0xff, 0xff, 0xff, 0xff, 0xff, 0xff, 0xff, 0xe0
};
const unsigned char rain[] PROGMEM = {
  // 'rain', 59x55px
  0xff, 0xff, 0xff, 0xff, 0xff, 0xff, 0xff, 0xe0, 0xff, 0xff, 0xff, 0xff, 0xff, 0xff, 0xff, 0xe0,
  0xff, 0xff, 0xff, 0xc0, 0x3f, 0xff, 0xff, 0xe0, 0xff, 0xff, 0xff, 0x00, 0x0f, 0xff, 0xff, 0xe0,
  0xff, 0xff, 0xf8, 0x00, 0x01, 0xff, 0xff, 0xe0, 0xff, 0xff, 0xf0, 0x00, 0x00, 0xff, 0xff, 0xe0,
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  0xff, 0xff, 0xff, 0xff, 0xff, 0xff, 0xff, 0xe0
};
const unsigned char sleet[] PROGMEM = {
  // 'sleet', 60x54px
  0xff, 0xff, 0xff, 0xff, 0xff, 0xff, 0xff, 0xf0, 0xff, 0xff, 0xff, 0xff, 0xff, 0xff, 0xff, 0xf0,
  0xff, 0xff, 0xff, 0xff, 0xff, 0xff, 0xff, 0xf0, 0xff, 0xff, 0xff, 0xff, 0xff, 0xff, 0xff, 0xf0,
  0xff, 0xff, 0xff, 0xff, 0xff, 0xff, 0xff, 0xf0, 0xff, 0xff, 0xff, 0xff, 0xff, 0xff, 0xff, 0xf0,
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  0xff, 0xff, 0xff, 0xff, 0xff, 0xff, 0xff, 0xf0, 0xff, 0xff, 0xff, 0xff, 0xff, 0xff, 0xff, 0xf0
};
const unsigned char snow[] PROGMEM = {
  // 'snow(1)', 57x58px
  0xff, 0xff, 0xff, 0xf0, 0xff, 0xff, 0xff, 0x80, 0xff, 0xff, 0xff, 0xf0, 0x7f, 0xff, 0xff, 0x80,
  0xff, 0xff, 0xff, 0xe0, 0x7f, 0xff, 0xff, 0x80, 0xff, 0xff, 0xff, 0xe0, 0x3f, 0xff, 0xff, 0x80,
  0xff, 0xff, 0xff, 0xf0, 0x7f, 0xff, 0xff, 0x80, 0xff, 0xff, 0xff, 0xf0, 0x7f, 0xff, 0xff, 0x80,
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  0xff, 0xff, 0xff, 0xf0, 0xff, 0xff, 0xff, 0x80, 0xff, 0xff, 0xff, 0xf9, 0xff, 0xff, 0xff, 0x80
};
const unsigned char thunderstrom_drizzle[] PROGMEM = {
  // 'thunderstorm with drizzle', 59x55px
  0xff, 0xff, 0xff, 0xff, 0xff, 0xff, 0xff, 0xe0, 0xff, 0xff, 0xff, 0xff, 0xff, 0xff, 0xff, 0xe0,
  0xff, 0xff, 0xff, 0xff, 0xff, 0xff, 0xff, 0xe0, 0xff, 0xff, 0xff, 0xff, 0xff, 0xff, 0xff, 0xe0,
  0xff, 0xff, 0xff, 0xff, 0xff, 0xff, 0xff, 0xe0, 0xff, 0xff, 0xff, 0xff, 0xff, 0xff, 0xff, 0xe0,
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  0xff, 0xff, 0xf7, 0xff, 0xff, 0xff, 0xff, 0xe0
};
const unsigned char unknown_prep[] PROGMEM = {
  // 'unknown prep', 59x54px
  0xff, 0xff, 0xff, 0xff, 0xff, 0xff, 0xff, 0xe0, 0xff, 0xff, 0xff, 0xff, 0xff, 0xff, 0xff, 0xe0,
  0xff, 0xff, 0xff, 0xff, 0xff, 0xff, 0xff, 0xe0, 0xff, 0xff, 0xff, 0xff, 0xff, 0xff, 0xff, 0xe0,
  0xff, 0xff, 0xff, 0xff, 0xff, 0xff, 0xff, 0xe0, 0xff, 0xff, 0xff, 0xff, 0xff, 0xff, 0xff, 0xe0,
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  0xff, 0xff, 0xff, 0xff, 0xff, 0xff, 0xff, 0xe0, 0xff, 0xff, 0xff, 0xff, 0xff, 0xff, 0xff, 0xe0
};

const unsigned char sol[] PROGMEM = {
  0xff, 0xff, 0xff, 0xff, 0xff, 0xff, 0xff, 0xff, 0xff, 0xff, 0xff, 0xff, 0xff, 0xff, 0xff, 0xff,
  0xff, 0xff, 0xff, 0xff, 0xff, 0xff, 0xff, 0xff, 0xff, 0xff, 0xff, 0xff, 0xff, 0xff, 0xff, 0xff,
  0xff, 0xff, 0xff, 0xff, 0xff, 0xff, 0xff, 0xff, 0xff, 0xff, 0xff, 0xff, 0xff, 0xff, 0xff, 0xff,
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  0xff, 0xff, 0xff, 0xff, 0xff, 0xff, 0xff, 0xff, 0xff, 0xff, 0xff, 0xff, 0xff, 0xff, 0xff, 0xff
};




/***************************Configuração da rede local WIFI *************************/
const char* ssid = "xxxxxxxxxxxxxxxx";    // SSID of local network
const char* password = "xxxxxxxxxxxxxxxxxxxx";  // Password on network

String APIKEY = "53c1a08909532fdf41f09935d9dea67d"; //key de acesso ao site de previsao do tempo 
String CityID = "8010625";  //ID de setubal
bool id = false;
WiFiClient client;
char servername[] = "api.openweathermap.org";  // remote server we will connect to
String result;

unsigned long lastTime = 0; //timer para o website
unsigned long timerDelay = 30000;//30 segundos.

TaskHandle_t Task1; //ID do processo no core 0

///função que desenha icones de tempo no inicio do programa
void displaywidget() {
  // Displays all the weather icons
  delay(5000);
  display.clearDisplay();
  display.drawBitmap(30, 0, thunderstorm_rain, 57, 56, BLACK, WHITE);
  display.display();
  delay(300);
  display.clearDisplay();
  display.drawBitmap(30, 0, thunderstrom_drizzle, 57, 56, BLACK, WHITE);
  display.display();
  delay(300);
  display.clearDisplay();
  display.drawBitmap(30, 0, drizzle, 57, 54, BLACK, WHITE);
  display.display();
  delay(300);
  display.clearDisplay();
  display.drawBitmap(30, 0, rain, 57, 54, BLACK, WHITE);
  display.display();
  delay(300);
  display.clearDisplay();
  display.drawBitmap(30, 0, snow, 57, 54, BLACK, WHITE);
  display.display();
  delay(300);
  display.clearDisplay();
  display.drawBitmap(30, 0, sleet, 57, 54, BLACK, WHITE);
  display.display();
  delay(300);
  display.clearDisplay();
  display.drawBitmap(30, 0, mist, 57, 54, BLACK, WHITE);
  display.display();
  delay(300);
  display.clearDisplay();
  display.drawBitmap(30, 0, cloudy, 57, 54, BLACK, WHITE);
  display.display();
  delay(300);
  display.clearDisplay();
  display.drawBitmap(30, 0, unknown_prep, 57, 54, BLACK, WHITE);
  display.display();
  delay(300);
  display.clearDisplay();
  display.drawBitmap(30, 0, sol, 57, 54, BLACK, WHITE);
  display.display();
  delay(1000);
  display.clearDisplay();
  display.setTextColor(WHITE);
  display.setCursor(25, 0);
  display.setTextSize(2);
  display.println("OLED");
  display.println("WEATHER");
  display.println("MONITORING");
  display.display();
  delay(5000);
  display.invertDisplay(1);
  delay(500);
}


/**** processa os requests do WEBSITE*/
String processor(const String& var) {
  float Humidity = dht.readHumidity();
  // Read temperature as Celsius (the default)
  float temperature_Celsius = dht.readTemperature();
  // Read temperature as Fahrenheit (isFahrenheit = true)
  float temperature_Fahrenheit = dht.readTemperature(true);
  float lux = lightMeter.readLightLevel();
  float altitude = bmp.readAltitude(1015.8);
  if (var == "TEMPERATURE_C") {
    return String(temperature_Celsius);
  } else if (var == "TEMPERATURE_F") {
    return String(temperature_Fahrenheit);
  } else if (var == "HUMIDITY") {
    return String(Humidity);
  } else if (var == "lux") {
    return String(lux);
  } else if (var == "ALTITUDE") {
    return String(altitude);
  }
}

/////função que ira correr no CORE 0 do ESP32 o loop normal corre no CORE 1 pro defeito
void task1Func(void* pvParameters) {
  for (;;) {

    if (client.connect(servername, 80)) {  //starts client connection, checks for connection
      client.println("GET /data/2.5/weather?id=" + CityID + "&units=metric&APPID=" + APIKEY + "&lang=pt");
      client.println("Host: api.openweathermap.org");
      client.println("User-Agent: ArduinoWiFi/1.1");
      client.println("Connection: close");
      client.println();
    } else {
      Serial.println("connection failed");  //error message if no client connect
      Serial.println();
    }

    while (client.connected() && !client.available())
      delay(1);                                         //waits for data
    while (client.connected() || client.available()) {  //connected or data available
      char c = client.read();                           //gets byte from ethernet buffer
      result = result + c;
    }

    client.stop();  //stop client
    result.replace('[', ' ');
    result.replace(']', ' ');
    //Serial.println(result);
    char jsonArray[result.length() + 1];
    result.toCharArray(jsonArray, sizeof(jsonArray));
    jsonArray[result.length() + 1] = '\0';
    StaticJsonDocument<1024> doc;
    DeserializationError error = deserializeJson(doc, jsonArray);


    if (error) {
      Serial.print(F("deserializeJson() failed with code "));
      Serial.println(error.c_str());
      return;
    }

    //campos que vai buscar á resposta GET ao site
    String location = doc["name"];
    String country = doc["sys"]["country"];
    int temperature = doc["main"]["temp"];
    int humidity = doc["main"]["humidity"];
    float pressure = doc["main"]["pressure"];
    int id = doc["id"];
    float Speed = doc["wind"]["speed"];
    int degree = doc["wind"]["deg"];
    float longitude = doc["coord"]["lon"];
    float latitude = doc["coord"]["lat"];

    /*****para verificar no serial se os dados estão ok*/
    Serial.println();
    Serial.print("Country: ");
    Serial.println(country);
    Serial.print("Location: ");
    Serial.println(location);
    Serial.print("Location ID: ");
    Serial.println(id);
    Serial.printf("Temperature: %d°C\r\n", temperature);
    Serial.printf("Humidity: %d %%\r\n", humidity);
    Serial.printf("Pressure: %.2f hpa\r\n", pressure);
    Serial.printf("Wind speed: %.1f m/s\r\n", Speed);
    Serial.printf("Wind degree: %d°\r\n", degree);
    Serial.printf("Longitude: %.2f\r\n", longitude);
    Serial.printf("Latitude: %.2f\r\n", latitude);
    /*********************/

    /**no display oled mostra os dados*/
    display.clearDisplay();
    display.setCursor(0, 0);  // Start at top-left corner
    display.setTextColor(SSD1306_WHITE, SSD1306_BLACK);
    display.print("Local: ");
    display.print(country);
    display.print(" ");
    display.println(location);
    display.println();
    display.setTextColor(SSD1306_WHITE, SSD1306_BLACK);
    display.print("Temp: ");
    display.print(temperature);
    display.print((char)247);
    display.print("C ");
    display.print("Humid: ");
    display.print(humidity);
    display.println("%");
    display.print("Pressao:");
    display.print(pressure);
    display.println("hpa");
    display.print("WinDSpeed: ");
    display.print(Speed);
    display.print("m/s   ");
    display.print("Latitude: ");
    display.print(latitude);
    display.println(" ");
    display.print("Longitude:");
    display.print(longitude);
    display.setTextColor(SSD1306_BLACK, SSD1306_WHITE);
    display.display();
    delay(600000);  // espera 10 minutos para nao esgotar o plafond de consultas gratis  ao site
    // ou seja, o core 0 fica parado 10 minutos de cada vez*/
  }
}


/****função principal de setup*/  ///
void setup() {
  Serial.begin(9600);
  display.begin(SSD1306_SWITCHCAPVCC, 0x3C);  // endereço do display OLED
  displaywidget();
  
  //***************** ligar a rede wifi e envia info para o OLED*/
  Serial.print("A ligar ao WIFI ");
  WiFi.mode(WIFI_STA);
  Serial.println(ssid);
  WiFi.begin(ssid, password);  //liga á rede wireless


  delay(300);
  display.clearDisplay();
  display.setTextSize(1);
  display.setTextColor(SSD1306_WHITE);
  display.setCursor(0, 0);
  display.print("Ligando.");
  display.display();
  while (WiFi.status() != WL_CONNECTED) {
    delay(500);
    Serial.print(".");
    display.print(".");
    display.display();
  }

  Serial.println("");
  Serial.println("IP address: ");
  Serial.println(WiFi.localIP());
  display.clearDisplay();
  display.setCursor(0, 0);
  display.println("Ligado ");
  display.println("IP Address: ");  //indica o IP da atribuido pela rede a que se ligou
  display.println(WiFi.localIP());
  display.display();
  delay(1000);
 // Blynk.begin(BLYNK_AUTH_TOKEN, ssid, password);  /**************************/
  display.clearDisplay();
  delay(2000);
  // servidor WEB da pagina onde estão os dados
  server.on("/", HTTP_GET, [](AsyncWebServerRequest* request) {
    request->send_P(200, "text/html", index_html, processor);
  });

  // Handle Web Server Events
  events.onConnect([](AsyncEventSourceClient* client) {
    if (client->lastId()) {
      Serial.printf("Client reconnected! Last message ID that it got is: %u\n", client->lastId());
    }
    // send event with message "hello!", id current millis
    // and set reconnect delay to 1 second
    client->send("hello!", NULL, millis(), 10000);
  });
  server.addHandler(&events);
  server.begin();

  /******************************************************************************/
  // define que a função task1Func irá correr no core 0 do ESP ou seja, é independente da função loop*/
  //////
  xTaskCreatePinnedToCore(
    task1Func, /* Task function. */
    "Task1",   /* name of task. */
    100000,    /* Stack size of task */
    NULL,      /* parameter of the task */
    2,         /* priority of the task */
    &Task1,    /* Task handle to keep track of created task */
    0);        /* pin task to core 0 */
  delay(500);
  /**************************************************************************/
  // *******************************inicializa LCD*****************************************/
  lcd.init();
  lcd.backlight();
  /****************************************************************************************/

  dht.begin();         //inicializa o sensor de temperatura
  lightMeter.begin();  //inicializa o sensor de Luminosidade


  //inicializa o sensor BMP 280***********************************************************/
  Serial.println(F("BMP280 test"));
  if (!bmp.begin(0x76)) {
    Serial.println(F("Could not find a valid BMP280 sensor, check wiring!"));
    while (1)
      ;
  }
  /* Default settings from datasheet. */
  bmp.setSampling(Adafruit_BMP280::MODE_NORMAL,     /* Operating Mode. */
                  Adafruit_BMP280::SAMPLING_X2,     /* Temp. oversampling */
                  Adafruit_BMP280::SAMPLING_X16,    /* Pressure oversampling */
                  Adafruit_BMP280::FILTER_X16,      /* Filtering. */
                  Adafruit_BMP280::STANDBY_MS_500); /* Standby time. */

  /*****************************************************************************************/
}


/***loop que corre no core 1*/  ///////
void loop() {
 
  delay(1000);

  // Reading temperature or humidity takes about 250 milliseconds!
  // Sensor readings may also be up to 2 seconds 'old' (its a very slow sensor)
  float h = dht.readHumidity();
  // Read temperature as Celsius (the default)
  float t = dht.readTemperature();
  // Read temperature as Fahrenheit (isFahrenheit = true)
  float f = dht.readTemperature(true);
  float lux = lightMeter.readLightLevel();
  float alt = bmp.readAltitude(1015.8); //de acordo com a pressão ao nivel do mar local

  // Check if any reads failed and exit early (to try again).
  if (isnan(h) || isnan(t) || isnan(f)) {
    Serial.println(F("Failed to read from DHT sensor!"));
    return;
  }
  /****enviar valores para o servidor web*/  //
                                             
  events.send("ping", NULL, millis());
  events.send(String(t).c_str(), "temperature_Celsius", millis());
  events.send(String(f).c_str(), "temperature_Fahrenheit", millis());
  events.send(String(h).c_str(), "humidity", millis());
  events.send(String(lux).c_str(), "lux", millis());
  events.send(String(alt).c_str(), "altitude", millis());
  lastTime = millis();

  /*********************testes serial*******************/
  //////////////do sensor DHT11
  Serial.print(F("Humidity: "));
  Serial.print(h);
  Serial.print(F("%  Temperature: "));
  Serial.print(t);
  Serial.println(F("°C "));
  //////////////////////////////////////
  /////////do BMP280
  Serial.print(F("Pressão:"));
  Serial.print(bmp.readPressure() / 100);  //displaying the Pressure in hPa, you can change the unit
  Serial.println(" hPa");
  Serial.print(F("Altitude aprox:"));
  Serial.print(alt);  
  Serial.println(" m");
  //////////////////////////
  ///BH1750/////////////////////////
  Serial.print("Light: ");
  Serial.print(lux);
  Serial.println(" lux");
  //////////fim dos testes serial/////////////////////////

  //dados do sensor DHT11 para o lcd
  lcd.setCursor(0, 0);
  lcd.print(F("Humidade: "));
  lcd.print(h);
  lcd.print(F("%  "));
  lcd.setCursor(0, 1);
  lcd.print(F("Celsius: "));
  lcd.print(t);
  lcd.print((char)223);
  lcd.print(F("C    "));
  delay(2000);
  lcd.setCursor(0, 1);
  lcd.print("Farhneit:");
  lcd.print(f);
  lcd.print((char)223);
  lcd.print(F("F "));
  delay(2000);
  //////////////////////////////////////////////


  //*****************dados do sensor BMP para o LCD*/
  lcd.setCursor(0, 0);
  lcd.print(F("  Pressao ATM    "));
  lcd.setCursor(0, 1);
  lcd.print(bmp.readPressure() / 100);
  lcd.print(" hPa      ");  // mostra a pressão atmosférica
  delay(2000);
  lcd.setCursor(0, 0);
  lcd.print(F("    Altitude     "));
  lcd.setCursor(0, 1);
  lcd.print(bmp.readAltitude(1015.8));
  lcd.print(" metros       ");  //mostra altitude aproximada de acordo com a pressão padrao ao nivel do mar em setubal
  delay(2000);
  /*****************************************************/

  /////////////////dados de luminosidade para o LCD/////////
  lcd.setCursor(0, 0);
  lcd.print("   Luminosidade ");
  lcd.setCursor(0, 1);
  lcd.print(lux);
  lcd.print(" lux  ");
  delay(2000);
  /*********************************************/
}

/*********************************************************************************************************
  END FILE
*********************************************************************************************************/